## meta-openbmc-machines/meta-x86/meta-mct/meta-tiogapass/conf/machine/tiogapass.conf
```bitbake
KMACHINE = "aspeed"
KERNEL_DEVICETREE = "${KMACHINE}-bmc-mct-tiogapass.dtb"

require conf/machine/include/ast2500.inc
require conf/machine/include/obmc-bsp-common.inc
require conf/machine/include/mct.inc

UBOOT_MACHINE = "ast_g5_phy_config"

FLASH_SIZE = "32768"

VIRTUAL-RUNTIME_skeleton_workbook = "${MACHINE}-config"
```
